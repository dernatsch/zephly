## dts/bindings/pwm-array.yaml
```yaml
description: |
    This binding provides means to collect pwm channels from multiple timers.

compatible: "pwm-array"

properties:
    pwms:
        type: phandle-array
        required: true
        description: |
          PWM pins that will be used for generating and capturing a pulse-width
          modulated signal. The pin at the first index will be used for signal
          generation while the pin at the second index will be used for capuring
          the generated signal. The two pins must be physically connected to
          each other.
```
